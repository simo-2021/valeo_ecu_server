## base_external/package/ecu_server/Config.in
```kconfig
config BR2_PACKAGE_ECU_SERVER
	bool "ecu_server"
	help
	  Includes the writer executable, finder.sh and tester.sh in the kernel image.
	  Used to understand buildroot external trees and package builds.
```
